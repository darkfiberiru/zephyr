## boards/xtensa/esp32_s3_devkitc_1/Kconfig.board
```kconfig
# ESP32S3 DevKitM board configuration

# Copyright (c) 2022 Espressif Systems (Shanghai) Co., Ltd.
# SPDX-License-Identifier: Apache-2.0

config BOARD_ESP32S3_DEVKITC
	bool "ESP32S3 DevKitC Board"
	depends on SOC_ESP32S3
```
